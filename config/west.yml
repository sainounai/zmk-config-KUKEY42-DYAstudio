## config/west.yml
```yaml
manifest:
  defaults:
    revision: main
  remotes:
    - name: cormoran
      url-base: https://github.com/cormoran
    - name: r-Keys-kbd
      url-base: https://github.com/r-Keys-kbd
    - name: kot149
      url-base: https://github.com/kot149
    - name: caksoylar
      url-base: https://github.com/caksoylar
  projects:
    - name: zmk
      remote: cormoran
      revision: v0.3-branch+dya
      import: app/west.yml
    - name: zmk-module-ble-management
      remote: cormoran
      revision: main
    - name: zmk-module-battery-history
      remote: cormoran
      revision: main
    - name: zmk-module-settings-rpc
      remote: cormoran
      revision: main
    - name: zmk-module-runtime-input-processor
      remote: cormoran
      revision: main
    - name: zmk-pmw3610-driver
      remote: r-Keys-kbd
      revision: main
    - name: zmk-mouse-gesture
      remote: kot149
      revision: v1
    - name: zmk-rgbled-widget
      remote: caksoylar
      revision: main
  self:
    path: config
```
